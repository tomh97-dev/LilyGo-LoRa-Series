#include <Arduino.h>
#include <lmic.h>
#include <hal/hal.h>
#include "boards.h"
#include "DallasTemperature.h"

int scanTime = 5; //In seconds
uint16_t beconUUID = 0xFEAA;
#define ENDIAN_CHANGE_U16(x) ((((x)&0xFF00)>>8) + (((x)&0xFF)<<8))

// LSB mode
static const u1_t PROGMEM DEVEUI[8] = { 0x2D, 0x13, 0xB2, 0x6C, 0xBE, 0x35, 0xE7, 0x10 };
// LSB mode
static const u1_t PROGMEM APPEUI[8] = { 0x00, 0x00, 0x00, 0x00, 0x00, 0x00, 0x00, 0x00 };
// MSB mode
static const u1_t PROGMEM APPKEY[16] = { 0x75, 0x7F, 0xE4, 0xB5, 0xD0, 0xBB, 0x39, 0x03, 0x9D, 0x24, 0x55, 0x35, 0xD8, 0x42, 0xCE, 0xD7 };

// Pin mapping
const lmic_pinmap lmic_pins = {
    .nss =  RADIO_CS_PIN,
    .rxtx = LMIC_UNUSED_PIN,
    .rst =  LMIC_UNUSED_PIN,
    .dio = {RADIO_DIO0_PIN, RADIO_DIO1_PIN, RADIO_BUSY_PIN}
};

static const unsigned char emptyCircle[] U8X8_PROGMEM = {
	0x00, 0xE0, 0x0F, 0x00, 0x00, 0xFC, 0x7F, 0x00, 0x00, 0x1F, 0xF0, 0x01, 
    0x80, 0x03, 0x80, 0x03, 0xE0, 0x00, 0x00, 0x0E, 0x70, 0x00, 0x00, 0x1C, 
    0x30, 0x00, 0x00, 0x18, 0x18, 0x00, 0x00, 0x30, 0x0C, 0x00, 0x00, 0x60, 
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    0x00, 0x1F, 0xF0, 0x01, 0x00, 0xFC, 0x7F, 0x00
};
static const unsigned char circle25[] U8X8_PROGMEM = {
	0x00, 0xE0, 0x0F, 0x00, 0x00, 0xFC, 0x7F, 0x00, 0x00, 0x1F, 0xFF, 0x01, 
    0x80, 0x03, 0xFF, 0x03, 0xE0, 0x00, 0xFF, 0x0F, 0x70, 0x00, 0xFF, 0x1F, 
    0x30, 0x00, 0xFF, 0x1F, 0x18, 0x00, 0xFF, 0x3F, 0x0C, 0x00, 0xFF, 0x7F, 
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    0x00, 0x1F, 0xF0, 0x01, 0x00, 0xFC, 0x7F, 0x00
};
static const unsigned char circle50[] U8X8_PROGMEM = {
    0x00, 0xE0, 0x0F, 0x00, 0x00, 0xFC, 0x7F, 0x00, 0x00, 0x1F, 0xFF, 0x01, 
    0x80, 0x03, 0xFF, 0x03, 0xE0, 0x00, 0xFF, 0x0F, 0x70, 0x00, 0xFF, 0x1F, 
    0x30, 0x00, 0xFF, 0x1F, 0x18, 0x00, 0xFF, 0x3F, 0x0C, 0x00, 0xFF, 0x7F, 
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    0x00, 0x1F, 0xFF, 0x01, 0x00, 0xFC, 0x7F, 0x00
};
static const unsigned char circle75[] U8X8_PROGMEM = {
	0x00, 0xE0, 0x0F, 0x00, 0x00, 0xFC, 0x7F, 0x00, 0x00, 0x1F, 0xFF, 0x01, 
    0x80, 0x03, 0xFF, 0x03, 0xE0, 0x00, 0xFF, 0x0F, 0x70, 0x00, 0xFF, 0x1F, 
    0x30, 0x00, 0xFF, 0x1F, 0x18, 0x00, 0xFF, 0x3F, 0x0C, 0x00, 0xFF, 0x7F, 
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    0x00, 0xFF, 0xFF, 0x01, 0x00, 0xFC, 0x7F, 0x00
};
static const unsigned char circle100[] U8X8_PROGMEM = {
	0x00, 0xE0, 0x0F, 0x00, 0x00, 0xFC, 0x7F, 0x00, 0x00, 0xFF, 0xFF, 0x01, 
    0x80, 0xFF, 0xFF, 0x03, 0xE0, 0xFF, 0xFF, 0x0F, 0xF0, 0xFF, 0xFF, 0x1F, 
    0xF0, 0xFF, 0xFF, 0x1F, 0xF8, 0xFF, 0xFF, 0x3F, 0xFC, 0xFF, 0xFF, 0x7F, 
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    0x00, 0xFF, 0xFF, 0x01, 0x00, 0xFC, 0x7F, 0x00
};
static const unsigned char circleCheck[] U8X8_PROGMEM = {
    0x00, 0xE0, 0x0F, 0x00, 0x00, 0xFC, 0x7F, 0x00, 0x00, 0xFF, 0xFF, 0x01, 
    0x80, 0xFF, 0xFF, 0x03, 0xE0, 0xFF, 0xFF, 0x0F, 0xF0, 0xFF, 0xFF, 0x1F, 
    0xF0, 0xFF, 0xFF, 0x1F, 0xF8, 0xFF, 0xFF, 0x3F, 0xFC, 0xFF, 0xFF, 0x7F, 
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    0x00, 0xFF, 0xFF, 0x01, 0x00, 0xFC, 0x7F, 0x00
};

static osjob_t sendjob;
static int spreadFactor = DR_SF7;
static int joinStatus = EV_JOINING;
static const unsigned TX_INTERVAL = 15;
static String lora_msg = "";
int joiningAnimationIndex = 0;
bool isJoining = false;
unsigned long previousMillis = 0;
const long interval = 500;

static int temp = 22;
static int pH = 7;
static int wq = 100;

void os_getArtEui (u1_t *buf)
{
    memcpy_P(buf, APPEUI, 8);
}

void os_getDevEui (u1_t *buf)
{
    memcpy_P(buf, DEVEUI, 8);
}

void os_getDevKey (u1_t *buf)
{
    memcpy_P(buf, APPKEY, 16);
}

void drawProgressCircle(U8G2 &u8g2, int progress) {
    const uint8_t *bitmap;
    switch(progress) {
        case 0:
            bitmap = emptyCircle;
            break;
        case 1:
            bitmap = circle25;
            break;
        case 2:
            bitmap = circle50;
            break;
        case 3:
            bitmap = circle75;
            break;
        case 4:
            bitmap = circle100;
            break;
        default:
            bitmap = emptyCircle;
            break;
    }
    u8g2.drawXBMP(48, 28, 32, 32, bitmap);
}
void updateJoiningAnimation() {
    if (!isJoining) {
        return;
    }   
    unsigned long currentMillis = millis();
    if (currentMillis - previousMillis >= interval) {
        previousMillis = currentMillis;
        if (u8g2) {
            u8g2->clearBuffer();
            u8g2->setFont(u8g2_font_unifont_t_symbols);
            u8g2->drawStr(20, 20, "Joining LNS");
            // uint16_t symbols[5] = {0x25CB, 0x25D4, 0x25D1, 0x25D5, 0x25CF};
            // uint16_t symbol = symbols[joiningAnimationIndex];
            // u8g2->drawGlyph(64, 32, symbol);
            drawProgressCircle(*u8g2, joiningAnimationIndex);
            u8g2->sendBuffer();
            joiningAnimationIndex = (joiningAnimationIndex + 1) % 5;
        }
    }
}
void readTemp() {
    uint8_t scaledValue = 0xFF;
}
void readpH() {
    uint8_t scaledValue = 0xFF;
}
void readWaterQuality() {
    uint8_t scaledValue = 0xFF;
}

void do_send(osjob_t *j)
{
    if (joinStatus == EV_JOINING) {
        Serial.println(F("Not joined yet"));
        // Check if there is not a current TX/RX job running
        os_setTimedCallback(&sendjob, os_getTime() + sec2osticks(TX_INTERVAL), do_send);

    } else if (LMIC.opmode & OP_TXRXPEND) {
        Serial.println(F("OP_TXRXPEND, not sending"));
    } else {
        Serial.println(F("OP_TXRXPEND,sending ..."));
        static uint8_t mydata[] = "Hello, world!";
        static uint8_t myBinaryData[] = {
            // readTemp(), readpH(), readWaterQuality()
        };
        // Prepare upstream data transmission at the next possible time.
        LMIC_setTxData2(1, myBinaryData, sizeof(myBinaryData), 0);
        os_setTimedCallback(&sendjob, os_getTime() + sec2osticks(TX_INTERVAL), do_send);

#ifdef HAS_DISPLAY
        // if (u8g2) {
        //     char buf[256];
        //     u8g2->clearBuffer();
        //     snprintf(buf, sizeof(buf), "[%lu]data sending!", millis() / 1000);
        //     u8g2->drawStr(0, 12, buf);
        //     u8g2->sendBuffer();
        // }
#endif
    }
}

void onEvent (ev_t ev)
{
    Serial.print(os_getTime());
    Serial.print(": ");
    switch (ev) {
    case EV_TXCOMPLETE:
        Serial.println(F("EV_TXCOMPLETE (includes waiting for RX windows)"));

        if (LMIC.txrxFlags & TXRX_ACK) {
            Serial.println(F("Received ack"));
            lora_msg =  "Received ACK.";
        }

        lora_msg = "rssi:" + String(LMIC.rssi) + " snr: " + String(LMIC.snr);

        if (LMIC.dataLen) {
            // data received in rx slot after tx
            Serial.print(F("Data Received: "));
            // Serial.write(LMIC.frame + LMIC.dataBeg, LMIC.dataLen);
            // Serial.println();
            Serial.println(LMIC.dataLen);
            Serial.println(F(" bytes of payload"));
        }
        // Schedule next transmission
        os_setTimedCallback(&sendjob, os_getTime() + sec2osticks(TX_INTERVAL), do_send);
        break;
    case EV_JOINING:
        isJoining = true;
        digitalWrite(BOARD_LED, LED_OFF);
        Serial.println(F("EV_JOINING: -> Joining..."));
        lora_msg = "OTAA joining....";
        joinStatus = EV_JOINING;
        break;
    case EV_JOIN_FAILED:
        isJoining = false;
        Serial.println(F("EV_JOIN_FAILED: -> Joining failed"));
        lora_msg = "OTAA Joining failed";
#ifdef HAS_DISPLAY
        if (u8g2) {
            u8g2->clearBuffer();
            u8g2->setFont(u8g2_font_unifont_t_symbols);
            u8g2->drawStr(0, 20, "Failed to join LNS!");
            u8g2->drawXBMP(48, 28, 32, 32, circle100);
            u8g2->sendBuffer();
        }
#endif
        break;
    case EV_JOINED:
        isJoining = false;
        digitalWrite(BOARD_LED, LED_ON);
        Serial.println(F("EV_JOINED -> Joined LORIOT!"));
        lora_msg = "Joined!";
        joinStatus = EV_JOINED;

#ifdef HAS_DISPLAY
        if (u8g2) {
            u8g2->clearBuffer();
            u8g2->setFont(u8g2_font_unifont_t_symbols);
            u8g2->drawStr(20, 20, "Joined LNS!");
            u8g2->drawXBMP(48, 28, 32, 32, circleCheck);
            u8g2->sendBuffer();
        }
#endif
        delay(3);
        // Disable link check validation (automatically enabled
        // during join, but not supported by TTN at this time).
        LMIC_setLinkCheckMode(0);

        break;
    case EV_RXCOMPLETE:
        // data received in ping slot
        Serial.println(F("EV_RXCOMPLETE"));
        break;
    case EV_LINK_DEAD:
        Serial.println(F("EV_LINK_DEAD"));
        break;
    case EV_LINK_ALIVE:
        Serial.println(F("EV_LINK_ALIVE"));
        break;
    default:
        Serial.println(F("Unknown event"));
        break;
    }
}

void setupLMIC(void)
{
    os_init();

    LMIC_reset();

    LMIC_setClockError(MAX_CLOCK_ERROR * 1 / 100);

    LMIC_setupChannel(0, 868100000, DR_RANGE_MAP(DR_SF12, DR_SF7),  BAND_CENTI);      // g-band
    LMIC_setupChannel(1, 868300000, DR_RANGE_MAP(DR_SF12, DR_SF7B), BAND_CENTI);      // g-band
    LMIC_setupChannel(2, 868500000, DR_RANGE_MAP(DR_SF12, DR_SF7),  BAND_CENTI);      // g-band
    LMIC_setupChannel(3, 867100000, DR_RANGE_MAP(DR_SF12, DR_SF7),  BAND_CENTI);      // g-band
    LMIC_setupChannel(4, 867300000, DR_RANGE_MAP(DR_SF12, DR_SF7),  BAND_CENTI);      // g-band
    LMIC_setupChannel(5, 867500000, DR_RANGE_MAP(DR_SF12, DR_SF7),  BAND_CENTI);      // g-band
    LMIC_setupChannel(6, 867700000, DR_RANGE_MAP(DR_SF12, DR_SF7),  BAND_CENTI);      // g-band
    LMIC_setupChannel(7, 867900000, DR_RANGE_MAP(DR_SF12, DR_SF7),  BAND_CENTI);      // g-band
    LMIC_setupChannel(8, 868800000, DR_RANGE_MAP(DR_FSK,  DR_FSK),  BAND_MILLI);      // g2-band
    // TTN defines an additional channel at 869.525Mhz using SF9 for class B
    // devices' ping slots. LMIC does not have an easy way to define set this
    // frequency and support for class B is spotty and untested, so this
    // frequency is not configured here.

    // Disable link check validation
    LMIC_setLinkCheckMode(0);

    // TTN uses SF9 for its RX2 window.
    LMIC.dn2Dr = DR_SF9;

    // Set data rate and transmit power for uplink (note: txpow seems to be ignored by the library)
    LMIC_setDrTxpow(spreadFactor, 14);

    // Start job
    LMIC_startJoining();

    do_send(&sendjob);     // Will fire up also the join
}

void loopLMIC(void)
{
    os_runloop_once();
    updateJoiningAnimation();
}